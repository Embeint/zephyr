## drivers/gnss/Kconfig.telit_le910cx
```kconfig
# Copyright (c) 2025 Embeint Pty Ltd
# SPDX-License-Identifier: Apache-2.0

config GNSS_TELIT_LE910CX
	bool "Telit LE910CX GNSS modem driver"
	default y
	depends on MODEM_CELLULAR
	depends on DT_HAS_TELIT_LE910C1TX_ENABLED
	depends on DT_HAS_TELIT_LE910CX_GNSS_ENABLED
	select MODEM_MODULES
	select MODEM_CHAT
	select MODEM_CHAT_COMMANDS_CONDITIONAL
	select MODEM_PIPE
	select MODEM_AT_USER_PIPE
	select GNSS_NMEA0183
	help
	  Enable Telit LE910CX GNSS modem driver.

config GNSS_TELIT_LE910CX_INIT_PRIORITY
	int "Telit LE910CX GNSS initialization priority"
	default 92
	depends on GNSS_TELIT_LE910CX
	help
	  Initialization priority of the Telit LE910CX GNSS driver. Must be
	  greater than MODEM_CELLULAR_INIT_PRIORITY, as the GNSS device is a
	  child of the cellular modem device.
```

## drivers/input/Kconfig.axs5106l
```kconfig
# SPDX-FileCopyrightText: Copyright The Zephyr Project Contributors
# SPDX-License-Identifier: Apache-2.0

config INPUT_AXS5106L
	bool "AXS5106L capacitive touch controller driver"
	default y
	depends on DT_HAS_CHIPSOURCETEK_AXS5106L_ENABLED
	select GPIO
	select I2C
	select INPUT_TOUCH
	help
	  Enable driver for the ChipSourceTek AXS5106L capacitive touch
	  controller.
```

## drivers/sensor/microchip/pac194x/Kconfig
```kconfig
# Microchip PAC195X power monitor driver
#
# Copyright (c) 2026 Google, LLC
#
# SPDX-License-Identifier: Apache-2.0

config PAC194X
	bool "PAC194X/PAC195X power monitor sensor"
	default y
	depends on DT_HAS_MICROCHIP_PAC194X_ENABLED
	select I2C
	select GPIO if $(dt_compat_any_has_prop,$(DT_COMPAT_MICROCHIP_PAC194X),power-down-gpios)
	help
	  Enables PAC194X/PAC195X power monitor driver.
```

## dts/bindings/fuel-gauge/zephyr,fuel-gauge-composite.yaml
```yaml
# Copyright (c) 2024 Embeint Inc
# SPDX-License-Identifier: Apache-2.0

description: |
  Composite fuel-gauge constructed from sensor devices

compatible: "zephyr,fuel-gauge-composite"

include: [fuel-gauge.yaml, battery.yaml]

properties:
  source-primary:
    type: phandle
    required: true
    description: |
      Primary device to read sensor data from.
      Device must implement the sensor API.

  source-secondary:
    type: phandle
    description: |
      Secondary device to read sensor data from.
      This device will be used if input-primary does not expose
      a channel.

      Device must implement the sensor API.

  source-secondary-fallback:
    type: boolean
    description: |
      Instead of the secondary device being used for channels the primary
      source does not expose, use it as a fallback measurement for the case
      the primary device fails.

  fuel-gauge-channels:
    type: boolean
    description: |
      Sources should be queried by the sensor API fuel gauge
      channels (SENSOR_CHAN_GAUGE_*), instead of the generic
      channels (SENSOR_CHAN_VOLTAGE, etc).

  charger-status:
    type: phandle
    description: |
      Charger device that exposes the `charger_status` property for charge
      state detection.

  charging-soc-estimator:
    type: boolean
    description: |
      Maintain a stateful state-of-charge estimate. Above
      charging-current-threshold-microamp, positive charging current is
      integrated using charge-full-design-microamp-hours. After charging, or after the
      charger stops reporting full, the estimate is gradually blended toward
      corrected OCV over the relaxation period.
      Corrected OCV is used otherwise.

      Requires charge-full-design-microamp-hours to be set.

      The estimate is only updated when the state of charge is read, so the
      application is expected to poll it regularly while charging. Charge is
      integrated using the current measured at each reading, so frequent
      polling tracks changes in charging current more closely. Gaps of more
      than 5 minutes between charging readings are not integrated. Instead,
      the reading after the gap uses corrected OCV and integration restarts
      from that reading.

  charging-current-threshold-microamp:
    type: int
    default: 10000
    description: |
      Positive charging current must exceed this value for the
      charging-soc-estimator to use coulomb counting instead of corrected OCV.

  ocv-relaxation-time-ms:
    type: int
    default: 60000
    description: |
      After significant charging ends, or the charger stops reporting full,
      time over which the estimator is recalibrated from its post-charge value
      to corrected OCV. The transition is measured from the last significant
      charging or full reading, and all
      subsequent readings, including discharge readings, advance it. A value
      of 0 switches to corrected OCV on the first reading after charging.
```

## dts/bindings/gnss/telit,le910cx-gnss.yaml
```yaml
# Copyright(c) 2025 Embeint Pty Ltd
# SPDX-License-Identifier: Apache-2.0

description: |
  Telit LE910Cx GNSS Modem

  Expects to be a child node of a "telit,le910c1tx" modem. Commands are sent
  over the AT user pipe, so the modem node must also be the "modem" alias.
  For example:

    aliases {
      modem = &telit_le910c1;
    };

    telit_le910c1: telit_le910c1 {
      compatible = "telit,le910c1tx";

      telit_le910c1_gnss: telit_le910c1_gnss {
        compatible = "telit,le910cx-gnss";
      };
    };

compatible: "telit,le910cx-gnss"

include: base.yaml

properties:
  active-antenna:
    type: boolean
    description:
      External LNA support should be enabled. If specified, the RF receiver is
      in low gain mode, suitable for use with active antennas. If not specified,
      the RF receiver is in high-gain mode, suitable for passive antennas.
```

## dts/bindings/i2c/i2c-controller.yaml
```yaml
# Copyright (c) 2017 I-SENSE group of ICCS
# SPDX-License-Identifier: Apache-2.0

# Common fields for I2C controllers

include: base.yaml

class: i2c

bus: i2c

properties:
  "#address-cells":
    required: true
    const: 1
  "#size-cells":
    required: true
    const: 0
  clock-frequency:
    type: int
    description: Initial clock frequency in Hz
  sq-size:
    type: int
    default: 4
    description: Size of the submission queue for blocking requests
  cq-size:
    type: int
    default: 4
    description: Size of the completion queue for blocking requests

  zephyr,transfer-timeout-ms:
    type: int
    description: |
      Maximum time to wait for an I2C transfer to complete, in milliseconds.
      When absent, the default value is CONFIG_I2C_TRANSFER_TIMEOUT_MS.

  zephyr,boot-recover:
    type: boolean
    description: |
      Recover the I2C bus on boot. This can be useful to ensure the I2C bus is
      in a known good state, in case the device rebooted in the middle of an I2C
      transaction. This MUST NOT be enabled if the I2C bus lines do not idle
      high on boot (e.g. if the bus is pulled up by a switched regulator).
```

## dts/bindings/input/chipsourcetek,axs5106l.yaml
```yaml
# SPDX-FileCopyrightText: Copyright The Zephyr Project Contributors
# SPDX-License-Identifier: Apache-2.0

description: |
  ChipSourceTek AXS5106L self-capacitive touch controller

  Example:

    &i2c0 {
      touch: axs5106l@63 {
        compatible = "chipsourcetek,axs5106l";
        reg = <0x63>;
        irq-gpios = <&gpio1 16 GPIO_ACTIVE_LOW>;
        reset-gpios = <&gpio1 15 GPIO_ACTIVE_LOW>;
      };
    };

compatible: "chipsourcetek,axs5106l"

include: [i2c-device.yaml, touchscreen-common.yaml]

properties:
  irq-gpios:
    type: phandle-array
    required: true
    description: |
      Interrupt GPIO. Asserted by the controller when touch data is
      available. Active low.

  reset-gpios:
    type: phandle-array
    description: |
      Reset GPIO (RESX). Active low.
```

## dts/bindings/modem/telit,le910c1tx.yaml
```yaml
# Copyright(c) 2026 Telit Cinterion S.p.A. All rights reserved.
# SPDX-License-Identifier: Apache-2.0

description: Telit LE910C1tx Modem

compatible: "telit,le910c1tx"

include: zephyr,cellular-modem-device.yaml

properties:
  mdm-power-gpios:
    type: phandle-array
    required: true

  mdm-reset-gpios:
    type: phandle-array
    required: true

  sim-detect:
    type: string
    enum:
      - "active-low"
      - "active-high"
      - "force-present"
    description: |
      SIM card detection configuration applied during modem initialization.
      If not specified, the modem SIM detection configuration is left unchanged.
      - active-low: SIM presence detected from the SIMIN pin, SIM present when low.
      - active-high: SIM presence detected from the SIMIN pin, SIM present when high.
      - force-present: SIMIN pin ignored, SIM always considered present.
```

## tests/drivers/entropy/rp2040_rosc/testcase.yaml
```yaml
tests:
  drivers.entropy.rp2040_rosc:
    tags: [drivers, entropy]
    platform_allow: [mps2/an385]
    integration_platforms: [mps2/an385]
```

## tests/drivers/fuel_gauge/composite/testcase.yaml
```yaml
tests:
  drivers.fuel_gauge.composite:
    tags:
      - fuel_gauge
    platform_allow:
      - native_sim
```

## tests/drivers/gpio/cyw43/testcase.yaml
```yaml
tests:
  drivers.gpio.cyw43:
    tags: [drivers, gpio]
    platform_allow: [mps2/an385]
    integration_platforms: [mps2/an385]
```

## tests/drivers/modem/modem_3gpp/testcase.yaml
```yaml
tests:
  drivers.modem.modem_3gpp:
    tags:
      - drivers
      - modem
    platform_allow:
      - native_sim
    integration_platforms:
      - native_sim
```

## tests/net/lib/dns_fallback_real/testcase.yaml
```yaml
common:
  tags:
    - dns
    - net
  timeout: 60
  platform_allow:
    - native_sim
  integration_platforms:
    - native_sim
tests:
  net.dns.fallback.real:
    harness: ztest
```
