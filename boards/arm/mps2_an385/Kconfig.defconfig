## subsys/modem/Kconfig
```kconfig
# Copyright (c) 2023 Trackunit Corporation
# SPDX-License-Identifier: Apache-2.0

menuconfig MODEM_MODULES
	bool "Modem modules"
	select EXPERIMENTAL

if MODEM_MODULES

config MODEM_DEDICATED_WORKQUEUE
	bool "Use a dedicated workqueue for modem operations"

if MODEM_DEDICATED_WORKQUEUE

config MODEM_DEDICATED_WORKQUEUE_STACK_SIZE
	int "Modem dedicated workqueue stack size"
	default 1024

config MODEM_DEDICATED_WORKQUEUE_PRIORITY
	int "Modem dedicated workqueue priority"
	default SYSTEM_WORKQUEUE_PRIORITY

endif # MODEM_DEDICATED_WORKQUEUE

config MODEM_CHAT
	bool "Modem chat module"
	select RING_BUFFER
	select MODEM_PIPE

if MODEM_CHAT

config MODEM_CHAT_LOG_BUFFER_SIZE
	int "Modem chat log buffer size in bytes"
	default 128

endif

config MODEM_CMUX
	bool "Modem CMUX module"
	select MODEM_PIPE
	select RING_BUFFER
	select EVENTS
	select CRC

if MODEM_CMUX

config MODEM_CMUX_DEFAULT_MTU_127
	bool
	default y if (DT_HAS_QUECTEL_BG95_ENABLED || DT_HAS_QUECTEL_EG25_G_ENABLED || \
		      DT_HAS_SIMCOM_SIM7080_ENABLED || DT_HAS_U_BLOX_SARA_R4_ENABLED || \
		      DT_HAS_U_BLOX_SARA_R5_ENABLED || DT_HAS_SWIR_HL7800_ENABLED || \
		      DT_HAS_TELIT_ME910G1_ENABLED || DT_HAS_TELIT_ME310G1_ENABLED || \
			  DT_HAS_TELIT_LE910CX_ENABLED || \
		      DT_HAS_SQN_GM02S_ENABLED || DT_HAS_QUECTEL_EG800Q_ENABLED || \
		      DT_HAS_SIMCOM_A76XX_ENABLED)
	help
	  Use the default MTU size of 127 bytes for the CMUX module on certain modems.
	  This must match the AT+CMUX commands in the modem_cellular driver.

config MODEM_CMUX_MTU
	int "CMUX MTU size in bytes"
	range 16 1500
	default 127 if MODEM_CMUX_DEFAULT_MTU_127
	default 31
	help
	  Maximum Transmission Unit (MTU) size for the CMUX module.
	  Linux ldattach defaults to 127 bytes, 3GPP TS 27.010 to 31.

config MODEM_CMUX_WORK_BUFFER_SIZE_EXTRA
	int "CMUX module extra work buffer size in bytes"
	default 0
	help
	  Extra bytes to add to the work buffers used by the CMUX module.
	  The default size of these buffers is MODEM_CMUX_MTU + 7 (CMUX header size).

config MODEM_CMUX_DLCI_AUTO_MSC_V24_READY
	bool "DLCI channels need to be set to ready through a MSC command"
	default y if DT_HAS_TELIT_LE910CX_ENABLED
	help
	  For some modems, after a DLCI channel is opened from a UA notification,
	  it starts in a disabled state. Enabling this option automatically enables the
	  channel through a MSC Virtual V.24 command. See 3GPP TS 27.010 for information
	  on command formats.

config MODEM_CMUX_DLCI_AT_ECHO_DEDICATED
	bool "DLCI channel AT echo configuration not copied from parent configuration"
	default y if DT_HAS_TELIT_LE910CX_ENABLED
	help
	  Some modems don't propagate the AT echo state from the primary comms channel to
	  the virtual CMUX DLCI channels. If set, users should run the
	  CONFIG_MODEM_CMUX_DLCI_AT_ECHO_DISABLE_COMMAND command on channel open to disable AT
	  command echoes.

config MODEM_CMUX_DLCI_AT_ECHO_DISABLE_COMMAND
	string "Command to use to disable AT command echoes on CMUX DLCI channels"
	depends on MODEM_CMUX_DLCI_AT_ECHO_DEDICATED
	default "ATE0"
	help
	  Command to run to disable AT command echoes.

module = MODEM_CMUX
module-str = modem_cmux
source "subsys/logging/Kconfig.template.log_config"

endif

config MODEM_PIPE
	bool "Modem pipe module"
	select EVENTS

config MODEM_PIPELINK
	bool "Modem pipelink module"
	depends on MODEM_PIPE

config MODEM_PPP
	bool "Modem PPP module"
	depends on NET_L2_PPP
	select MODEM_PIPE
	select RING_BUFFER
	select CRC

if MODEM_PPP

config MODEM_PPP_NET_BUF_FRAG_SIZE
	int "Network buffer fragment size"
	default NET_BUF_DATA_SIZE if NET_BUF_FIXED_DATA_SIZE
	default 128

endif

config MODEM_STATS
	bool "Modem statistics"
	depends on SHELL
	help
	  Enables modem statistics shell commands which track the usage of
	  buffers across the modem modules. The statistics are useful for
	  scaling buffer sizes, as these are application specific.

config MODEM_STATS_BUFFER_NAME_SIZE
	int "Maximum string size of modem stats buffer name"
	default 32
	range 8 64

config MODEM_UBX
	bool "Modem U-BLOX module"
	select RING_BUFFER
	select MODEM_PIPE
	help
	  Enable Modem U-BLOX module.

if MODEM_UBX

config MODEM_UBX_LOG_BUFFER
	int "Modem U-BLOX log buffer size"
	default 128

endif

module = MODEM_MODULES
module-str = modem_modules
source "subsys/logging/Kconfig.template.log_config"

rsource "backends/Kconfig"

endif
```

## tests/lib/math/interpolation/testcase.yaml
```yaml
# Copyright (c) 2024 Embeint Pty Ltd
# SPDX-License-Identifier: Apache-2.0

tests:
  math.interpolation:
    integration_platforms:
      - native_sim
```

## tests/subsys/zbus/runtime_channels/testcase.yaml
```yaml
tests:
  message_bus.zbus.runtime_channels:
    tags: zbus
    integration_platforms:
      - native_sim
```
