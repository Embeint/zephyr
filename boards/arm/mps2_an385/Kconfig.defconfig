## boards/arm/mps2_an385/Kconfig.defconfig
```kconfig
# Copyright (c) 2017 Linaro Limited
# SPDX-License-Identifier: Apache-2.0

if BOARD_MPS2_AN385

config BOARD
	default "mps2_an385"

if SERIAL

config UART_INTERRUPT_DRIVEN
	default y

endif # SERIAL

config ZTEST_STACK_SIZE
	default 8192 if ZTEST

if COVERAGE_GCOV

config MAIN_STACK_SIZE
	default 8192

config IDLE_STACK_SIZE
	default 8192

config PRIVILEGED_STACK_SIZE
	default 8192

config ISR_STACK_SIZE
	default 8192

config TEST_EXTRA_STACK_SIZE
	default 8192

endif # COVERAGE_GCOV

endif
```

## boards/nordic/nrf7002dk/Kconfig.nrf7002dk
```kconfig
# Copyright (c) 2024 Nordic Semiconductor
# SPDX-License-Identifier: Apache-2.0

config BOARD_NRF7002DK
	select SOC_NRF5340_CPUNET_QKAA if BOARD_NRF7002DK_NRF5340_CPUNET
	select SOC_NRF5340_CPUAPP_QKAA if BOARD_NRF7002DK_NRF5340_CPUAPP
	select SOC_NRF5340_CPUAPP_QKAA if BOARD_NRF7002DK_NRF5340_CPUAPP_NS
	select SOC_NRF5340_CPUAPP_QKAA if BOARD_NRF7002DK_NRF5340_CPUAPP_NRF7001
```

## drivers/charger/Kconfig.bq25190
```kconfig
# Copyright (c) 2025 Embeint Pty Ltd
#
# SPDX-License-Identifier: Apache-2.0

menuconfig CHARGER_BQ25190
	bool "BQ25190 Battery Charger"
	default y
	depends on DT_HAS_TI_BQ25190_CHARGER_ENABLED
	select I2C
	select MFD
	help
	  Enable the Texas Instruments BQ25190 PMIC Battery Charger

if CHARGER_BQ25190

module = CHARGER_BQ25190
module-str = BQ25190 Charger
source "subsys/logging/Kconfig.template.log_config"

endif # CHARGER_BQ25190
```

## drivers/gpio/Kconfig.bq25190
```kconfig
# Copyright (c) 2025 Embeint Pty Ltd
#
# SPDX-License-Identifier: Apache-2.0

config GPIO_BQ25190
	bool "BQ25190 GPIO driver"
	default y
	depends on DT_HAS_TI_BQ25190_GPIO_ENABLED
	select I2C
	select MFD
	help
	  Enable the Texas Instruments BQ25190 PMIC GPIO

if GPIO_BQ25190

config GPIO_BQ25190_INIT_PRIORITY
	int "BQ25190 GPIO driver init priority"
	default 56
	help
	  Init priority for the TI BQ25190 GPIO driver.
	  It must be greater than the MFD init priority.

endif # GPIO_BQ25190
```

## drivers/mfd/Kconfig.bq25190
```kconfig
# Copyright (c) 2025 Embeint Pty Ltd
# SPDX-License-Identifier: Apache-2.0

config MFD_BQ25190
	bool "BQ25190 battery charger, regulator, ADC multi-function device driver"
	default y
	depends on DT_HAS_TI_BQ25190_ENABLED
	select I2C
	help
	  Enable the Texas Instruments BQ25190 Linear Battery Charger with
	  Integrated Buck-Boost, DVS Buck, LDOs and ADC multi-function device driver

config MFD_BQ25190_INIT_PRIORITY
	int "BQ25190 MFD initialization priority"
	default MFD_INIT_PRIORITY
	depends on MFD_BQ25190
	help
	  Multi-function device initialization priority for BQ25190.
```

## drivers/regulator/Kconfig.bq25190
```kconfig
# Copyright (c) 2025 Embeint Pty Ltd
# SPDX-License-Identifier: Apache-2.0

config REGULATOR_BQ25190
	bool "BQ25190 PMIC regulator driver"
	default y
	depends on DT_HAS_TI_BQ25190_REGULATOR_ENABLED
	select I2C
	select GPIO
	select MFD
	help
	  Enable the Texas Instruments BQ25190 PMIC regulator driver

if REGULATOR_BQ25190

config REGULATOR_BQ25190_INIT_PRIORITY
	int "BQ25190 regulator driver init priority"
	default 56
	help
	  Init priority for the TI BQ25190 regulator driver.
	  It must be greater than the MFD init priority.

module = REGULATOR_BQ25190
module-str = BQ25190 Regulator
source "subsys/logging/Kconfig.template.log_config"

endif # REGULATOR_BQ25190
```

## drivers/sensor/ti/bq25190/Kconfig
```kconfig
# Copyright (c) 2025 Embeint Pty Ltd
#
# SPDX-License-Identifier: Apache-2.0

menuconfig SENSOR_BQ25190
	bool "BQ25190 ADC channel sensor"
	default y
	depends on DT_HAS_TI_BQ25190_SENSOR_ENABLED
	select I2C
	select MFD
	help
	  Enable the Texas Instruments BQ25190 PMIC ADC sensor driver

if SENSOR_BQ25190

config SENSOR_BQ25190_INIT_PRIORITY
	int "BQ25190 sensor driver init priority"
	default 85
	help
	  Init priority for the TI BQ25190 sensor driver.
	  It must be greater than I2C init priority.

module = SENSOR_BQ25190
module-str = BQ25190 Sensor
source "subsys/logging/Kconfig.template.log_config"

endif # SENSOR_BQ25190
```

## dts/bindings/charger/ti,bq25190-charger.yaml
```yaml
# Copyright (c), 2025 Embeint Inc
# SPDX-License-Identifier: Apache-2.0

description: |
  Texas Instruments BQ25190 PMIC Battery Charger

compatible: "ti,bq25190-charger"

include: battery.yaml

properties:
  constant-charge-current-max-microamp:
    required: true
    description: |
      The charge current target for the constant current phase of the charge profile.
      This value will be set at initialization time. Range: 5 mA to 1000 mA.
      The value specified will be rounded down to the closest implemented value.

  constant-charge-voltage-max-microvolt:
    required: true
    description: |
      The voltage regulation target for the constant voltage phase of the battery charging profile.
      This value will be set at initialization time. Range: 3.50 V to 4.65 V.
      The value specified will be rounded down to the closest implemented value.

  vin-overvoltage-protection-millivolt:
    type: int
    enum:
      - 5700
      - 18500
    default: 18500
    description: |
      Vin overvoltage protection threshold. Default is the POR value.

  sys-regulation-voltage:
    type: string
    enum:
      - "VBAT"
      - "4.4V"
      - "4.5V"
      - "4.6V"
      - "4.7V"
      - "4.8V"
      - "4.9V"
      - "Passthrough"
    default: "4.5V"
    description: |
      SYS regulation voltage target when Vin present. Default is the POR value.

  input-current-limit-microamp:
    type: int
    enum:
      - 25000
      - 50000
      - 90000
      - 200000
      - 300000
      - 475000
      - 665000
      - 1050000
    default: 475000
    description: |
      Vin input current limit. Default is the POR value.

  ts-monitoring-disable:
    type: boolean
    description: |
      Disable thermistor monitoring, allowing charging while the TS pin is
      outside configured limits.
```

## dts/bindings/gpio/ti,bq25190-gpio.yaml
```yaml
# Copyright (c), 2025 Embeint Inc
# SPDX-License-Identifier: Apache-2.0

description: |
  Texas Instruments BQ25190 PMIC GPIO

compatible: "ti,bq25190-gpio"

include: gpio-controller.yaml

gpio-cells:
  - pin
  - flags
```

## dts/bindings/i2c/nordic,nrf-twi-common.yaml
```yaml
# Copyright (c) 2018 Aapo Vienamo
# Copyright (c) 2018 Nordic Semiconductor ASA
# SPDX-License-Identifier: Apache-2.0

# Common fields for Nordic nRF family TWI peripherals

include: [i2c-controller.yaml, pinctrl-device.yaml]

properties:
  reg:
    required: true

  interrupts:
    required: true

  pinctrl-0:
    required: true

  easydma-maxcnt-bits:
    type: int
    required: true
    description: |
      Maximum number of bits available in the EasyDMA MAXCNT register. This
      property must be set at SoC level DTS files.

  zephyr,no-boot-recover:
    type: boolean
    description: |
      Don't attempt to recover the bus on boot. This can be required if connected
      sensors are not powered but the I2C bus is directly connected. One example
      of this design is the Thingy53.
```

## dts/bindings/iio/afe/current-sense-amplifier.yaml
```yaml
# Copyright 2023 The ChromiumOS Authors
# SPDX-License-Identifier: Apache-2.0

description: |
  When an io-channel measures the voltage over a current sense amplifier,
  the interesting measurement is almost always the current through the
  sense resistor, not the voltage over it. This binding describes such a current
  sense circuit.

  This is based on Linux, documentation:
    https://www.kernel.org/doc/Documentation/devicetree/bindings/iio/afe/current-sense-amplifier.yaml

compatible: "current-sense-amplifier"

include: base.yaml

properties:
  io-channels:
    required: true
    description: |
      Channels available with this divider configuration.

  sense-resistor-milli-ohms:
    type: int
    required: true
    description: |
      Resistance of the shunt resistor in milli-ohms.

  sense-gain-mult:
    type: int
    default: 1
    description: |
      Amplifier gain multiplier. The default is <1>. The maximum value is <65535>.

  sense-gain-div:
    type: int
    default: 1
    description: |
      Amplifier gain divider. The default is <1>. The maximum value is <65535>.

  power-gpios:
    type: phandle-array
    description: |
      Control power to the current amplifier.

      If present the corresponding GPIO must be set to an active level
      to enable the current amplifier.

  gain-extended-range:
    type: string
    description: |
      Alternate gain to use if primary measurement hits limit:
      - ADC_GAIN_1_6: x 1/6
      - ADC_GAIN_1_5: x 1/5
      - ADC_GAIN_1_4: x 1/4
      - ADC_GAIN_1_3: x 1/3
      - ADC_GAIN_2_5: x 2/5
      - ADC_GAIN_1_2: x 1/2
      - ADC_GAIN_2_3: x 2/3
      - ADC_GAIN_4_5: x 4/5
      - ADC_GAIN_1:   x 1
      - ADC_GAIN_2:   x 2
      - ADC_GAIN_3:   x 3
      - ADC_GAIN_4:   x 4
      - ADC_GAIN_6:   x 6
      - ADC_GAIN_8:   x 8
      - ADC_GAIN_12:  x 12
      - ADC_GAIN_16:  x 16
      - ADC_GAIN_24:  x 24
      - ADC_GAIN_32:  x 32
      - ADC_GAIN_64:  x 64
      - ADC_GAIN_128: x 128
    enum:
      - "ADC_GAIN_1_6"
      - "ADC_GAIN_1_5"
      - "ADC_GAIN_1_4"
      - "ADC_GAIN_1_3"
      - "ADC_GAIN_2_5"
      - "ADC_GAIN_1_2"
      - "ADC_GAIN_2_3"
      - "ADC_GAIN_4_5"
      - "ADC_GAIN_1"
      - "ADC_GAIN_2"
      - "ADC_GAIN_3"
      - "ADC_GAIN_4"
      - "ADC_GAIN_6"
      - "ADC_GAIN_8"
      - "ADC_GAIN_12"
      - "ADC_GAIN_16"
      - "ADC_GAIN_24"
      - "ADC_GAIN_32"
      - "ADC_GAIN_64"
      - "ADC_GAIN_128"
```

## dts/bindings/mfd/ti,bq25190.yaml
```yaml
# Copyright (c) 2025 Embeint Pty Ltd
# SPDX-License-Identifier: Apache-2.0

description: Texas Instruments BQ25190

compatible: "ti,bq25190"

include: i2c-device.yaml

properties:
  reg:
    required: true

  int-gpios:
    type: phandle-array
    description: GPIO for interrupt input

  enable-gpios:
    type: phandle-array
    description: GPIO for chip enable

  buck-reset-force-1v8:
    type: boolean
    description: |
      Before performing a soft-reset, force the GPIO3 and GPIO4 pins low so that
      immediately after the soft-reset, the BUCK output is set to 1.8V.

  buck-gpio-controlled-voltage:
    type: boolean
    description: |
      Keep the IC default behaviour of setting the BUCK regulator voltage from
      the state of GPIO3 and GPIO4, instead of setting these pins to inputs
      and explicitly setting the voltage.
```

## dts/bindings/modem/telit,le910cx-le.yaml
```yaml
# Copyright(c) 2026 Embeint Pty Ltd
# SPDX-License-Identifier: Apache-2.0

description: Telit LE910Cx Linux Modem

compatible: "telit,le910cx-le"

include: zephyr,cellular-modem-device.yaml

properties:
  mdm-power-gpios:
    type: phandle-array
    required: true

  mdm-reset-gpios:
    type: phandle-array
    required: true

  zephyr,mdm-reset-behavior:
    default: ["toggle_on_recovery", "toggle_on_resume"]
```

## dts/bindings/modem/telit,le910cx.yaml
```yaml
# Copyright(c) 2025 Embeint Pty Ltd
# SPDX-License-Identifier: Apache-2.0

description: Telit LE910Cx Modem

compatible: "telit,le910cx"

include: uart-device.yaml

properties:
  mdm-power-gpios:
    type: phandle-array
    required: true

  mdm-reset-gpios:
    type: phandle-array
    required: true

  target-speed:
    type: int
    default: 921600
    description:
      UART baudrate which will be requested using AT commands and to which
      UART interface will be reconfigured during initialization phase.
```

## dts/bindings/modem/u-blox,lara-r6.yaml
```yaml
# Copyright (c) 2024, lindq.gr
# SPDX-License-Identifier: Apache-2.0

description: u-blox LARA-R6 modem

compatible: "u-blox,lara-r6"

include: zephyr,cellular-modem-device.yaml

properties:
  mdm-power-gpios:
    type: phandle-array
    required: true

  zephyr,mdm-reset-behavior:
    default: ["toggle_on_recovery"]

  target-speed:
    type: int
    default: 3000000
    description:
      UART baudrate which will be requested using AT commands and to which
      UART interface will be reconfigured during initialization phase.
```

## dts/bindings/regulator/ti,bq25190-regulator.yaml
```yaml
# Copyright (c), 2025 Embeint Inc
# SPDX-License-Identifier: Apache-2.0

description: |
  Texas Instruments BQ25190 PMIC

  The PMIC has one buck converter, one buck-boost converter, and two LDOs.
  The regulators need to be defined as child nodes, strictly following the
  BUCK, BUCK_BOOST, LDO1..2, node names. For
  example:

  pmic@6c {
    reg = <0x6c>;
    ...
    regulators {
      compatible = "ti,bq25190-regulator";

      BUCK {
        /* all properties for BUCK */
      };
      BUCK_BOOST {
        /* all properties for BUCK_BOOST */
      };
      LDO1 {
        /* all properties for LDO1 */
      };
      LDO2 {
        /* all properties for LDO2 */
      };
    };
  };

compatible: "ti,bq25190-regulator"

child-binding:
  include:
    - name: regulator.yaml
      property-allowlist:
        - regulator-always-on
        - regulator-boot-on
        - regulator-boot-off
        - regulator-min-microvolt
        - regulator-max-microvolt
        - regulator-init-microvolt

  properties:
    ldo-mode-switch:
      type: boolean
      description: |
        LDO is configured as a switch instead of a voltage regulator.
        Only valid for the LDO nodes.

    gpio-controlled:
      type: boolean
      description: |
        BQ25190 GPIO state controls regulator state. Use when an external
        driver needs the GPIO node.
                Buck Regulator: GPIO3
          Buck Boost Regulator: GPIO2
         LDO1 Regulator/Switch: GPIO4
         LDO2 Regulator/Switch: GPIO1
```

## dts/bindings/sensor/ti,bq25190-sensor.yaml
```yaml
# Copyright (c), 2025 Embeint Inc
# SPDX-License-Identifier: Apache-2.0

description: |
  Texas Instruments BQ25190 PMIC ADC Sensor

  Interface to the internal ADC measurement channels

compatible: "ti,bq25190-sensor"

properties:
  adc-resolution:
    type: int
    enum:
      - 11
      - 10
      - 9
    default: 9
    description: |
      Effective resolution of the ADC, driven by the sampling speed.
      Default is the POR value.

  adcin-bias:
    type: boolean
    description: |
      Enable the 80uA internal biasing for the ADCIN pin.
```

## dts/bindings/wifi/nordic,nrf70-spi.yaml
```yaml
# Copyright (c) 2024 Nordic Semiconductor ASA
# SPDX-License-Identifier: Apache-2.0

description: nRF70 Wi-Fi chip with SPI interface.

include: ["nordic,nrf70.yaml", "spi-device.yaml"]

properties:
  cs-gpio-low-on-deinit:
    type: boolean
    description: |
      When VDDIO is not applied, IO pins must not be driving a voltage
      onto the nRF70. Enabling this option explicitly drives the CS pin
      low when the device is not active.
```

## samples/tfm_integration/devicetree_layout/tfm_default/sample.yaml
```yaml
sample:
  description: TF-M with default partitions
  name: tfm-default-partitions
tests:
  sample.tfm.tfm_default:
    tags: trusted-firmware-m
    build_only: true
    platform_allow:
      - nrf5340dk_nrf5340_cpuapp_ns
    integration_platforms:
      - nrf5340dk_nrf5340_cpuapp_ns
```

## samples/tfm_integration/devicetree_layout/tfm_ext_secondary/sample.yaml
```yaml
sample:
  description: TF-M with no secondary image
  name: tfm-external-secondary
tests:
  sample.tfm.tfm_no_secondary:
    tags: trusted-firmware-m
    build_only: true
    platform_allow:
      - nrf5340dk_nrf5340_cpuapp_ns
    integration_platforms:
      - nrf5340dk_nrf5340_cpuapp_ns
```
