/**
 * @file
 * @copyright 2024 Embeint Inc
 * @author Jordan Yates <jordan@embeint.com>
 *
 * SPDX-License-Identifier: LicenseRef-Embeint
 *
 * BL2 provisioning is concerned with the ROT public key for image validation only.
 * Since there is no private information in these public keys, compiling them into
 * the bootloader itself has no security implications.
 */

#include <stdint.h>
#include <string.h>

#include "tfm_plat_provisioning.h"
#include "tfm_plat_otp.h"

#include "bootutil/bootutil_log.h"

#ifdef MCUBOOT_SIGN_EC384
#define PUB_KEY_HASH_SIZE (48)
#define PUB_KEY_SIZE      (100) /* Size must be aligned to 4 Bytes */

/* bl2/ext/mcuboot/root-EC-P384.pem */
static const uint8_t bl2_default_rotpk_0[PUB_KEY_SIZE] = {
	0x04, 0x0c, 0x76, 0xca, 0xae, 0x72, 0x3a, 0xa5, 0xe8, 0xf0, 0xd4, 0xf1, 0x16, 0xb5,
	0x02, 0xef, 0x77, 0xa1, 0x1b, 0x93, 0x61, 0x78, 0xc0, 0x09, 0x26, 0x7b, 0x3b, 0x40,
	0x9c, 0xee, 0x49, 0x85, 0xe0, 0xc9, 0x4f, 0xe7, 0xf2, 0xba, 0x97, 0x6c, 0xf3, 0x82,
	0x65, 0x14, 0x2c, 0xf5, 0x0c, 0x73, 0x33, 0x4d, 0x32, 0xe7, 0x9b, 0xd3, 0x42, 0xcc,
	0x95, 0x5a, 0xe5, 0xe2, 0xf5, 0xf4, 0x6e, 0x45, 0xe0, 0xed, 0x20, 0x35, 0x5c, 0xaf,
	0x52, 0x35, 0x81, 0xd4, 0xdc, 0x9c, 0xe3, 0x9e, 0x22, 0x3e, 0xfb, 0x3f, 0x22, 0x10,
	0xda, 0x70, 0x03, 0x37, 0xad, 0xa8, 0xf2, 0x48, 0xfe, 0x3a, 0x60, 0x69, 0xa5,
};

/* bl2/ext/mcuboot/root-EC-P384_1.pem */
static const uint8_t bl2_default_rotpk_1[PUB_KEY_SIZE] = {
	0x04, 0x34, 0x43, 0xad, 0x59, 0x83, 0xd9, 0x41, 0x65, 0xdc, 0x20, 0xb8, 0x62, 0x35,
	0xf8, 0x7d, 0x94, 0x13, 0x5e, 0x75, 0xe6, 0xa8, 0x79, 0xe9, 0xcb, 0xfd, 0xa7, 0x2e,
	0x92, 0x95, 0x82, 0xa6, 0xc5, 0xdd, 0x53, 0xc7, 0x3d, 0x46, 0xed, 0x75, 0xd5, 0x20,
	0xb5, 0xbe, 0x74, 0x2a, 0x6d, 0x30, 0xe2, 0x31, 0x50, 0x1c, 0x7f, 0xc7, 0x7b, 0x4a,
	0x73, 0x55, 0xf8, 0x92, 0x60, 0xff, 0x2f, 0x18, 0x04, 0xbc, 0xc7, 0xd9, 0xce, 0xda,
	0xa6, 0x36, 0x52, 0xec, 0x2b, 0x64, 0x6e, 0x7a, 0x97, 0x60, 0x9d, 0x8c, 0xba, 0xfe,
	0xec, 0x9a, 0xb0, 0xc2, 0x6e, 0x3d, 0x75, 0x2a, 0x98, 0xb2, 0xa3, 0x09, 0x84,
};

#else
#define PUB_KEY_HASH_SIZE (32)
#define PUB_KEY_SIZE      (68) /* Size must be aligned to 4 Bytes */

/* bl2/ext/mcuboot/root-EC-P256.pem */
static const uint8_t bl2_default_rotpk_0[PUB_KEY_SIZE] = {
	0x04, 0x2a, 0xcb, 0x40, 0x3c, 0xe8, 0xfe, 0xed, 0x5b, 0xa4, 0x49, 0x95, 0xa1,
	0xa9, 0x1d, 0xae, 0xe8, 0xdb, 0xbe, 0x19, 0x37, 0xcd, 0x14, 0xfb, 0x2f, 0x24,
	0x57, 0x37, 0xe5, 0x95, 0x39, 0x88, 0xd9, 0x94, 0xb9, 0xd6, 0x5a, 0xeb, 0xd7,
	0xcd, 0xd5, 0x30, 0x8a, 0xd6, 0xfe, 0x48, 0xb2, 0x4a, 0x6a, 0x81, 0x0e, 0xe5,
	0xf0, 0x7d, 0x8b, 0x68, 0x34, 0xcc, 0x3a, 0x6a, 0xfc, 0x53, 0x8e, 0xfa, 0xc1,
};

/* bl2/ext/mcuboot/root-EC-P256_1.pem */
static const uint8_t bl2_default_rotpk_1[PUB_KEY_SIZE] = {
	0x04, 0xe8, 0x09, 0x08, 0x12, 0x3a, 0x0f, 0xad, 0x40, 0xe0, 0x33, 0x8a, 0xa6,
	0x54, 0xf8, 0x83, 0x95, 0x41, 0x8e, 0x44, 0x99, 0xa2, 0x0f, 0xae, 0x85, 0x69,
	0x2b, 0xf9, 0x26, 0xb5, 0xe9, 0x9e, 0x16, 0x2c, 0x87, 0x76, 0x62, 0x7f, 0x32,
	0x6c, 0x9b, 0x70, 0x78, 0x06, 0x52, 0x52, 0x52, 0xca, 0x2b, 0xd2, 0xb7, 0xc7,
	0x50, 0x07, 0x66, 0x3b, 0x3b, 0xdf, 0xe1, 0x99, 0x69, 0x00, 0x26, 0x2c, 0x33,
};

#endif /* MCUBOOT_SIGN_EC384 */

#include BL2_ECDSA_PUBKEY_S
#include BL2_ECDSA_PUBKEY_NS

void tfm_plat_provisioning_check_for_dummy_keys(void)
{
	if ((memcmp(bl2_default_rotpk_0, bl2_rotpk_0, sizeof(bl2_rotpk_0)) == 0) ||
	    (memcmp(bl2_default_rotpk_1, bl2_rotpk_1, sizeof(bl2_rotpk_1)) == 0)) {
		BOOT_LOG_WRN("%s%s%s%s", "\033[1;31m",
			     "This device was provisioned with dummy keys. ",
			     "This device is \033[1;1mNOT SECURE", "\033[0m");
	}
}

int tfm_plat_provisioning_is_required(void)
{
	enum tfm_plat_err_t err;
	enum plat_otp_lcs_t lcs;

	err = tfm_plat_otp_read(PLAT_OTP_ID_LCS, sizeof(lcs), (uint8_t *)&lcs);
	if (err != TFM_PLAT_ERR_SUCCESS) {
		return err;
	}

	return lcs == PLAT_OTP_LCS_ASSEMBLY_AND_TEST || lcs == PLAT_OTP_LCS_PSA_ROT_PROVISIONING;
}

enum tfm_plat_err_t provision_assembly_and_test(void)
{
	enum tfm_plat_err_t err;

	err = tfm_plat_otp_write(PLAT_OTP_ID_BL2_ROTPK_0, PUB_KEY_SIZE, bl2_rotpk_0);
	if (err != TFM_PLAT_ERR_SUCCESS && err != TFM_PLAT_ERR_UNSUPPORTED) {
		return err;
	}
	err = tfm_plat_otp_write(PLAT_OTP_ID_BL2_ROTPK_1, PUB_KEY_SIZE, bl2_rotpk_1);
	if (err != TFM_PLAT_ERR_SUCCESS && err != TFM_PLAT_ERR_UNSUPPORTED) {
		return err;
	}
	return TFM_PLAT_ERR_SUCCESS;
}

enum tfm_plat_err_t tfm_plat_provisioning_perform(void)
{
	enum plat_otp_lcs_t lcs;
	enum tfm_plat_err_t err;

	err = tfm_plat_otp_read(PLAT_OTP_ID_LCS, sizeof(lcs), (uint8_t *)&lcs);
	if (err != TFM_PLAT_ERR_SUCCESS) {
		return err;
	}

	BOOT_LOG_INF("Beginning BL2 provisioning (nRF)");

	if (lcs == PLAT_OTP_LCS_ASSEMBLY_AND_TEST) {
		err = provision_assembly_and_test();
		if (err != TFM_PLAT_ERR_SUCCESS) {
			BOOT_LOG_ERR("Provisioning failed");
			return err;
		}
	}
}
